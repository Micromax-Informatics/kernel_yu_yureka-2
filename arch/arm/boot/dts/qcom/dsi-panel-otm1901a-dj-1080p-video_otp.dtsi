/* Copyright (c) 2013-2014, The Linux Foundation. All rights reserved.
 *
 * This program is free software; you can redistribute it and/or modify
 * it under the terms of the GNU General Public License version 03 and
 * only version 03 as published by the Free Software Foundation.
 *
 * This program is distributed in the hope that it will be useful,
 * but WITHOUT ANY WARRANTY; without even the implied warranty of
 * MERCHANTABILITY or FITNESS FOR A PARTICULAR PURPOSE.  See the
 * GNU General Public License for more details.
 */

&mdss_mdp {
	dsi_otm1901a_1080_otp_vid: qcom,mdss_dsi_otm1901a_dj_1080p_video_otp {
		qcom,mdss-dsi-panel-name = "otm1901a_1080p_video_DJ_otp";
		qcom,mdss-dsi-panel-controller = <&mdss_dsi0>;
		qcom,mdss-dsi-panel-type = "dsi_video_mode";
		qcom,mdss-dsi-panel-destination = "display_1";
		qcom,mdss-dsi-panel-framerate = <59>;
		qcom,mdss-dsi-virtual-channel-id = <0>;
		qcom,mdss-dsi-stream = <0>;
		qcom,mdss-dsi-panel-width = <1080>;
		qcom,mdss-dsi-panel-height = <1920>;
		qcom,mdss-dsi-h-front-porch = <320>;
		qcom,mdss-dsi-h-back-porch = <32>;
		qcom,mdss-dsi-h-pulse-width = <4>;
		qcom,mdss-dsi-h-sync-skew = <0>;
		qcom,mdss-dsi-v-back-porch = <9>;
		qcom,mdss-dsi-v-front-porch = <14>;
		qcom,mdss-dsi-v-pulse-width = <2>;
		qcom,mdss-dsi-h-left-border = <0>;
		qcom,mdss-dsi-h-right-border = <0>;
		qcom,mdss-dsi-v-top-border = <0>;
		qcom,mdss-dsi-v-bottom-border = <0>;
		qcom,mdss-dsi-bpp = <24>;
		qcom,mdss-dsi-underflow-color = <0xff>;
		qcom,mdss-dsi-border-color = <0>;
		qcom,mdss-dsi-on-command = [
			29 01 00 00 00 00 02 00 00
			29 01 00 00 00 00 04 ff 19 01 01
			29 01 00 00 00 00 02 00 80
			29 01 00 00 00 00 03 ff 19 01
		        29 01 00 00 00 00 02 00 00
		        29 01 00 00 00 00 02 35 00 
		        29 01 00 00 00 00 02 00 80
		        29 01 00 00 00 00 02 C4 13
		        29 01 00 00 00 00 02 00 00
		        29 01 00 00 00 00 04 ff ff ff ff
			05 01 00 00 78 00 02 11 00
			05 01 00 00 00 00 02 29 00
                        29 01 00 00 00 00 02 00 00
		        29 01 00 00 00 00 03 99 11 11];
		qcom,mdss-dsi-off-command = [29 01 00 00 00 00 02 00 00
		        29 01 00 00 00 00 03 99 95 27
		        05 01 00 00 32 00 02 28 00
			05 01 00 00 78 00 02 10 00
			29 01 00 00 00 00 02 00 00
			29 01 00 00 00 00 05 f7 5a a5 19 01
                        29 01 00 00 00 00 02 00 00
		        29 01 00 00 00 00 03 99 11 11];
		qcom,mdss-dsi-on-command-state = "dsi_lp_mode";
		qcom,mdss-dsi-off-command-state = "dsi_lp_mode";
		qcom,mdss-dsi-h-sync-pulse = <1>;
		qcom,mdss-dsi-traffic-mode = "burst_mode";
		qcom,mdss-dsi-bllp-eof-power-mode;
		qcom,mdss-dsi-bllp-power-mode;	
		qcom,mdss-dsi-hfp-power-mode;
		qcom,mdss-dsi-lane-0-state;
		qcom,mdss-dsi-lane-1-state;
		qcom,mdss-dsi-lane-2-state;
		qcom,mdss-dsi-lane-3-state;
		qcom,mdss-dsi-panel-timings = [04 3E 2A 01 70 76 2E 42 33 03 04 00];
                qcom,mdss-dsi-panel-timings-8996 = [25 1F 09 0A 06 03 04 a0
		25 1F 09 0A 06 03 04 a0
		25 1F 09 0A 06 03 04 a0
		25 1F 09 0A 06 03 04 a0
		25 1E 08 0A 06 03 04 a0];
		qcom,mdss-dsi-t-clk-post = <0x2>;
		qcom,mdss-dsi-t-clk-pre = <0x2F>;
		qcom,mdss-dsi-bl-min-level = <1>;
		qcom,mdss-dsi-bl-max-level = <4095>;
		qcom,mdss-dsi-dma-trigger = "trigger_sw";
		qcom,mdss-dsi-mdp-trigger = "none";
		qcom,mdss-dsi-bl-pmic-control-type = "bl_ctrl_wled";
		qcom,mdss-dsi-reset-sequence = <1 10>, <0 10>, <1 10>;



		qcom,esd-check-enabled;

                qcom,mdss-dsi-panel-status-command = [06 01 00 01 05 00 01 0A
						      06 01 00 01 05 00 01 0B];
                qcom,mdss-dsi-panel-status-command-state = "dsi_hs_mode";
                qcom,mdss-dsi-panel-status-check-mode = "reg_read";
                qcom,mdss-dsi-panel-status-valid-params = <1 1>;
                qcom,mdss-dsi-panel-status-value = <0x9c 0x00>;
                qcom,mdss-dsi-panel-status-read-length = <1 1>;





		qcom,mdss-dsi-lp11-init;
		qcom,mdss-dsi-init-delay-us = <10000>;
		qcom,mdss-pan-physical-width-dimension = <68>; 
		qcom,mdss-pan-physical-height-dimension = <120>;

	};
};

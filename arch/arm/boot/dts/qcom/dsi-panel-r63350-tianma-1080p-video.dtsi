/* Copyright (c) 2014, The Linux Foundation. All rights reserved.
 *
 * This program is free software; you can redistribute it and/or modify
 * it under the terms of the GNU General Public License version 2 and
 * only version 2 as published by the Free Software Foundation.
 *
 * This program is distributed in the hope that it will be useful,
 * but WITHOUT ANY WARRANTY; without even the implied warranty of
 * MERCHANTABILITY or FITNESS FOR A PARTICULAR PURPOSE.  See the
 * GNU General Public License for more details.
 */

/*---------------------------------------------------------------------------
 * This file is autogenerated file using gcdb parser. Please do not edit it.
 * Update input XML file to add a new entry or update variable in this file
 * VERSION = "1.0"
 *---------------------------------------------------------------------------*/
&mdss_mdp {
        dsi_r63350_1080p_video: qcom,mdss_dsi_r63350_1080p_video {
                qcom,mdss-dsi-panel-name = "r63350_1080p_video_Tcl";
                qcom,mdss-dsi-panel-controller = <&mdss_dsi0>;
                qcom,mdss-dsi-panel-type = "dsi_video_mode";
                qcom,mdss-dsi-panel-destination = "display_1";
                qcom,mdss-dsi-panel-framerate = <59>;
                qcom,mdss-dsi-virtual-channel-id = <0>;
                qcom,mdss-dsi-stream = <0>;
                qcom,mdss-dsi-panel-width = <1080>;
                qcom,mdss-dsi-panel-height = <1920>;
                qcom,mdss-dsi-h-front-porch = <320>;
                qcom,mdss-dsi-h-back-porch = <36>;
                qcom,mdss-dsi-h-pulse-width = <12>;
                qcom,mdss-dsi-h-sync-skew = <0>;
                qcom,mdss-dsi-v-back-porch = <4>;
                qcom,mdss-dsi-v-front-porch = <4>;
                qcom,mdss-dsi-v-pulse-width = <2>;
                qcom,mdss-dsi-h-left-border = <0>;
                qcom,mdss-dsi-h-right-border = <0>;
                qcom,mdss-dsi-v-top-border = <0>;
                qcom,mdss-dsi-v-bottom-border = <0>;
                qcom,mdss-dsi-bpp = <24>;
                qcom,mdss-dsi-color-order = "rgb_swap_rgb";
                qcom,mdss-dsi-underflow-color = <0xff>;
                qcom,mdss-dsi-border-color = <0>;
                qcom,mdss-dsi-on-command = [ 
                        23 01 00 00 00 00 02 B0 04
                        29 01 00 00 00 00 07 B3 14 00 00 00 00 00
                        29 01 00 00 00 00 03 B4 0C 00
                        29 01 00 00 00 00 04 B6 4B DB 16
                        29 01 00 00 00 00 08 B8 57 3D 19 1E 0A 50 50
                        29 01 00 00 00 00 08 B9 6F 3D 28 3C 14 C8 C8
                        29 01 00 00 00 00 08 BA B5 33 41 64 23 A0 A0
                        29 01 00 00 00 00 03 BB 14 14
                        29 01 00 00 00 00 03 BC 37 32
                        29 01 00 00 00 00 03 BD 64 32
                        23 01 00 00 00 00 02 C0 00
                        29 01 00 00 00 00 23 C1 04 60 00 40 10 00 58 03 00 00 00 64 84 30 4A 00 00 9D C1 01 00 CA 00 00 00 00 00 00 42 00 02 20 03 98
                        29 01 00 00 00 00 09 C2 31 F7 80 06 08 00 00 08
                        29 01 00 00 00 00 04 C3 00 00 00
                        29 01 00 00 00 00 0C C4 70 00 00 00 00 00 00 00 00 01 06
                        29 01 00 00 00 00 16 C6 77 01 6E 02 67 00 00 00 00 00 00 00 00 00 00 00 00 04 19 0A 77
                        //29 01 00 00 00 00 1F C7 00 19 1F 28 34 40 4A 57 3B 43 4E 5B 65 6C 77 00 19 1F 28 34 40 4A 57 3B 43 4E 5B 65 6C 77// G2.2
                        29 01 00 00 00 00 1F C7 00 16 1D 25 32 3E 48 56 39 40 4B 57 61 68 77 00 16 1D 25 32 3E 48 56 39 40 4B 57 61 68 77
                        29 01 00 00 00 00 10 CB E6 E0 C7 63 00 00 00 00 20 E0 87 00 E8 00 00
                        23 01 00 00 00 00 02 CC 06
                        29 01 00 00 00 00 1A CE 55 40 49 53 59 5E 63 68 6E 74 7E 8A 98 A8 BB D0 FF 04 00 04 04 42 00 69 5A
                        29 01 00 00 00 00 0B D0 11 00 00 56 CB 40 19 19 09 00
                        29 01 00 00 00 00 05 D1 00 48 16 0F
                        29 01 00 00 00 00 1B D3 1B 33 99 BB B3 33 33 33 11 00 01 00 00 E8 A0 02 2F 27 33 33 72 12 8A 57 3D BC
                        29 01 00 00 00 00 05 D4 41 04 00 D5
                      //29 01 00 00 00 00 08 D5 00 00 00 01 31 01 31
                        23 01 00 00 00 00 02 D6 01
                        29 01 00 00 00 00 19 D7 BF F8 7F A8 CE 3E FC C1 E1 EF 83 07 3F 10 7F C0 01 E7 40 3C 00 C0 00 00
                        29 01 00 00 00 00 04 D9 20 00 14
                        29 01 00 00 00 00 05 DD 30 06 23 65
                        29 01 00 00 00 00 05 DE 00 3F FF 10
                        15 01 00 00 20 00 02 29 00
                        15 01 00 00 80 00 02 11 00];
                qcom,mdss-dsi-off-command = [05 01 00 00 10 00 02 28 00  
                                        05 01 00 00 78 00 02 10 00
                                        29 01 00 00 00 00 02 B0 04
                                        29 01 00 00 00 00 02 B1 01];
                qcom,mdss-dsi-on-command-state = "dsi_lp_mode";
                qcom,mdss-dsi-off-command-state = "dsi_hs_mode";
                qcom,mdss-dsi-init-last;
                qcom,mdss-dsi-h-sync-pulse = <1>;
                qcom,mdss-dsi-traffic-mode = "burst_mode";
                qcom,mdss-dsi-lane-map = "lane_map_0123";
                qcom,mdss-dsi-bllp-eof-power-mode;
                qcom,mdss-dsi-bllp-power-mode;
                qcom,mdss-dsi-lane-0-state;
                qcom,mdss-dsi-lane-1-state;
                qcom,mdss-dsi-lane-2-state;
                qcom,mdss-dsi-lane-3-state;
                qcom,mdss-dsi-panel-timings = [04 3E 2A 01 70 76 2E 42 33 03 04 00];
                qcom,mdss-dsi-panel-timings-8996 =[25 1F 09 0A 06 03 04 A0
                    25 1F 09 0A 06 03 04 A0
                    25 1F 09 0A 06 03 04 A0
                    25 1F 09 0A 06 03 04 A0
                    25 1E 08 0A 06 03 04 A0];
                qcom,mdss-dsi-t-clk-post = <0x02>;
                qcom,mdss-dsi-t-clk-pre = <0x2F>;
                qcom,mdss-dsi-bl-min-level = <1>;
                qcom,mdss-dsi-bl-max-level = <4095>;
                qcom,mdss-dsi-dma-trigger = "trigger_sw";
                qcom,mdss-dsi-mdp-trigger = "none";
                qcom,mdss-dsi-bl-pmic-control-type = "bl_ctrl_wled";
                qcom,mdss-dsi-reset-sequence = <1 10>, <0 10>, <1 20>;

		qcom,mdss-dsi-hfp-power-mode;
//        	qcom,mdss-dsi-hbp-power-mode;
//		qcom,mdss-dsi-hsa-power-mode;
		qcom,esd-check-enabled;
		qcom,mdss-dsi-panel-status-command = [06 01 00 01 05 00 01 0A];
		qcom,mdss-dsi-panel-status-command-state = "dsi_hs_mode";
		qcom,mdss-dsi-panel-status-check-mode = "reg_read";
		qcom,mdss-dsi-panel-status-valid-params = <1>;
		qcom,mdss-dsi-panel-status-value = <0x1C>;
		qcom,mdss-dsi-panel-status-read-length = <1>;
		qcom,mdss-dsi-lp11-init;
                qcom,mdss-dsi-init-delay-us = <50000>;
                qcom,mdss-pan-physical-width-dimension = <68>;
                qcom,mdss-pan-physical-height-dimension = <120>;

        };
};

